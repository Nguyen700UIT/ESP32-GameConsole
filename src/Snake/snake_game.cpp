#include "Snake/snake_game.h"
#include "Snake/config.h"

namespace snake {

const int BASE_MOVE_DELAY = 150;
int moveDelay = BASE_MOVE_DELAY;
const int MIN_MOVE_DELAY = 45;
const int MAX_MOVE_DELAY = 350;
const int SPEED_STEP = 50;
const unsigned long SPECIAL_BAIT_LIFETIME = 5000;
unsigned long prevTime = 0;
unsigned long currTime = 0;

int prevScore = -1;
int prevBestScore = -1;
int score = 0;
int bestScore = 0;
uint16_t GAME_GREEN = tft_snake.color565(21, 133, 50);
bool drewGameOverUI = false;
Bait bait;
Bait specialBait;
int normalBaitEaten = 0;
const uint16_t baitBmp[] PROGMEM = {
    0x1426, 0x1426, 0xa381, 0xa381, 0x1426, 0x1648, 0x1648, 0x1648, 0x1426, 0x1426, 0x1426, 0x1426, 
  0xa381, 0xa381, 0x1648, 0x1648, 0x1648, 0x1426, 0x1426, 0x1426, 0x1426, 0xf800, 0xf800, 0xa381, 
  0xf800, 0xf800, 0xf800, 0xf800, 0xf800, 0x1426, 0xf800, 0xf800, 0xf800, 0xf800, 0xf800, 0xf800, 
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  0xf800, 0xf800, 0x1426, 0x1426, 
};
const uint16_t baitBlueBmp[] PROGMEM = {
    0x1426, 0x1426, 0xA381, 0xA381, 0x1426, 0x1648, 0x1648, 0x1648, 0x1426, 0x1426, 0x1426, 0x1426,
  0xA381, 0xA381, 0x1648, 0x1648, 0x1648, 0x1426, 0x1426, 0x1426, 0x1426, 0x1C19, 0x1C19, 0xA381,
  0x1C19, 0x1C19, 0x1C19, 0x1C19, 0x1C19, 0x1426, 0x1C19, 0x1C19, 0x1C19, 0x1C19, 0x1C19, 0x1C19,
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  0x1C19, 0x1C19, 0x1426, 0x1426
};
const uint16_t baitYellowBmp[] PROGMEM = {
    0x1426, 0x1426, 0xA381, 0xA381, 0x1426, 0x1648, 0x1648, 0x1648, 0x1426, 0x1426, 0x1426, 0x1426,
  0xA381, 0xA381, 0x1648, 0x1648, 0x1648, 0x1426, 0x1426, 0x1426, 0x1426, 0xFF80, 0xFF80, 0xA381,
  0xFF80, 0xFF80, 0xFF80, 0xFF80, 0xFF80, 0x1426, 0xFF80, 0xFF80, 0xFF80, 0xFF80, 0xFF80, 0xFF80,
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  0xFF80, 0xFF80, 0x1426, 0x1426
};
const uint16_t baitGreenBmp[] PROGMEM = {
    0x1426, 0x1426, 0xA381, 0xA381, 0x1426, 0x1648, 0x1648, 0x1648, 0x1426, 0x1426, 0x1426, 0x1426,
  0xA381, 0xA381, 0x1648, 0x1648, 0x1648, 0x1426, 0x1426, 0x1426, 0x1426, 0x14E0, 0x14E0, 0xA381,
  0x14E0, 0x14E0, 0x14E0, 0x14E0, 0x14E0, 0x1426, 0x14E0, 0x14E0, 0x14E0, 0x14E0, 0x14E0, 0x14E0,
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  0x14E0, 0x14E0, 0x1426, 0x1426
};
const uint16_t baitRainbowBmp[] PROGMEM = {
    0x1426, 0x1426, 0x59E0, 0x59E0, 0x1426, 0x1648, 0x1648, 0x1648, 0x1426, 0x1426, 0x1426, 0x1426,
  0x59E0, 0x59E0, 0x1648, 0x1648, 0x1648, 0x1426, 0x1426, 0x1426, 0x1426, 0x04DD, 0x04DD, 0x59E0,
  0x01FF, 0x01FF, 0x601B, 0x601B, 0x601B, 0x1426, 0x0386, 0x0386, 0x04DD, 0x04DD, 0x04DD, 0x01FF,
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  0xFF80, 0xFF80, 0x1426, 0x1426
};
const uint16_t headBlueUp[] PROGMEM = {
    0x1426, 0x1c19, 0xffff, 0x1c19, 0xf800, 0xf800, 0x1c19, 0xffff, 0x1c19, 0x1426, 0x1c19, 0x1c19, 
  0xffff, 0x1c19, 0xf800, 0x1c19, 0x1c19, 0xffff, 0x1c19, 0x1c19, 0x1c19, 0x1c19, 0x1c19, 0x1c19, 
  0x1c19, 0x1c19, 0x1c19, 0x1c19, 0x1c19, 0x1c19, 0x1426, 0x1c19, 0x1c19, 0x1c19, 0x1c19, 0x1c19, 
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  0x1c19, 0x1c19, 0x1c19, 0x1c19, 
};
const uint16_t headBlueDown[] PROGMEM = {
    0x1c19, 0x1c19, 0x1c19, 0x1c19, 0x1c19, 0x1c19, 0x1c19, 0x1c19, 0x1c19, 0x1c19, 0x1c19, 0xffff, 
  0xffff, 0xffff, 0x1c19, 0x1c19, 0xffff, 0xffff, 0xffff, 0x1c19, 0x1c19, 0xffff, 0x0000, 0x0000, 
  0x1c19, 0x1c19, 0x0000, 0x0000, 0xffff, 0x1c19, 0x1c19, 0x1c19, 0x1c19, 0x1c19, 0x1c19, 0x1c19, 
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  0x1c19, 0xffff, 0x1c19, 0x1426, 
};
const uint16_t headBlueLeft[] PROGMEM = {
    0x1c19, 0x1c19, 0x1c19, 0x1c19, 0x1c19, 0x1426, 0x1426, 0x1c19, 0x1c19, 0x1426, 0x1c19, 0xffff, 
  0xffff, 0x1c19, 0x1c19, 0x1c19, 0x1c19, 0x1c19, 0x1c19, 0x1c19, 0x1c19, 0xffff, 0x0000, 0x1c19, 
  0x1c19, 0x1c19, 0x1c19, 0x1c19, 0xffff, 0xffff, 0x1c19, 0xffff, 0x0000, 0x1c19, 0x1c19, 0x1c19, 
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  0x1426, 0x1c19, 0x1c19, 0x1426, 
};
const uint16_t headBlueRight[] PROGMEM = {
    0x1426, 0x1c19, 0x1c19, 0x1426, 0x1426, 0x1c19, 0x1c19, 0x1c19, 0x1c19, 0x1c19, 0x1c19, 0x1c19, 
  0x1c19, 0x1c19, 0x1c19, 0x1c19, 0x1c19, 0xffff, 0xffff, 0x1c19, 0xffff, 0xffff, 0x1c19, 0x1c19, 
  0x1c19, 0x1c19, 0x1c19, 0x0000, 0xffff, 0x1c19, 0x1c19, 0x1c19, 0x1c19, 0x1c19, 0x1c19, 0x1c19, 
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  0x1c19, 0x1c19, 0x1c19, 0x1c19, 
};
const uint16_t snakeBlueBody[] PROGMEM = {
    0x1426, 0x1426, 0x1c19, 0x1c19, 0x1c19, 0x1c19, 0x1c19, 0x1c19, 0x1426, 0x1426, 0x1426, 0x1c19, 
  0x1c19, 0x12b0, 0x1c19, 0x1c19, 0x12b0, 0x1c19, 0x1c19, 0x1426, 0x1c19, 0x1c19, 0x12b0, 0x12b0, 
  0x1c19, 0x1c19, 0x12b0, 0x12b0, 0x1c19, 0x1c19, 0x1c19, 0x12b0, 0x12b0, 0x1c19, 0x1c19, 0x1c19, 
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  0x1c19, 0x1c19, 0x1426, 0x1426, 
};

const uint16_t headRedUp[] PROGMEM = {
  0x1426, 0xF9E0, 0xFFFF, 0xF9E0, 0xFE60, 0xFE60, 0xF9E0, 0xFFFF, 0xF9E0, 0x1426, 0xF9E0, 0xF9E0,
  0xFFFF, 0xF9E0, 0xFE60, 0xF9E0, 0xF9E0, 0xFFFF, 0xF9E0, 0xF9E0, 0xF9E0, 0xF9E0, 0xF9E0, 0xF9E0,
  0xF9E0, 0xF9E0, 0xF9E0, 0xF9E0, 0xF9E0, 0xF9E0, 0x1426, 0xF9E0, 0xF9E0, 0xF9E0, 0xF9E0, 0xF9E0,
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  0xF9E0, 0xF9E0, 0xF9E0, 0xF9E0
};

const uint16_t headRedDown[] PROGMEM = {
  0xF9E0, 0xF9E0, 0xF9E0, 0xF9E0, 0xF9E0, 0xF9E0, 0xF9E0, 0xF9E0, 0xF9E0, 0xF9E0, 0xF9E0, 0xFFFF,
  0xFFFF, 0xFFFF, 0xF9E0, 0xF9E0, 0xFFFF, 0xFFFF, 0xFFFF, 0xF9E0, 0xF9E0, 0xFFFF, 0x0000, 0x0000,
  0xF9E0, 0xF9E0, 0x0000, 0x0000, 0xFFFF, 0xF9E0, 0xF9E0, 0xF9E0, 0xF9E0, 0xF9E0, 0xF9E0, 0xF9E0,
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  0xF9E0, 0xFFFF, 0xF9E0, 0x1426
};

const uint16_t headRedRight[] PROGMEM = {
  0xF9E0, 0xF9E0, 0xF9E0, 0xF9E0, 0xF9E0, 0x1426, 0x1426, 0xF9E0, 0xF9E0, 0x1426, 0xF9E0, 0xFFFF,
  0xFFFF, 0xF9E0, 0xF9E0, 0xF9E0, 0xF9E0, 0xF9E0, 0xF9E0, 0xF9E0, 0xF9E0, 0xFFFF, 0x0000, 0xF9E0,
  0xF9E0, 0xF9E0, 0xF9E0, 0xF9E0, 0xFFFF, 0xFFFF, 0xF9E0, 0xFFFF, 0x0000, 0xF9E0, 0xF9E0, 0xF9E0,
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  0x1426, 0xF9E0, 0xF9E0, 0x1426
};

const uint16_t headRedLeft[] PROGMEM = {
  0x1426, 0xF9E0, 0xF9E0, 0x1426, 0x1426, 0xF9E0, 0xF9E0, 0xF9E0, 0xF9E0, 0xF9E0, 0xF9E0, 0xF9E0,
  0xF9E0, 0xF9E0, 0xF9E0, 0xF9E0, 0xF9E0, 0xFFFF, 0xFFFF, 0xF9E0, 0xFFFF, 0xFFFF, 0xF9E0, 0xF9E0,
  0xF9E0, 0xF9E0, 0xF9E0, 0x0000, 0xFFFF, 0xF9E0, 0xF9E0, 0xF9E0, 0xF9E0, 0xF9E0, 0xF9E0, 0xF9E0,
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  0xF9E0, 0xF9E0, 0xF9E0, 0xF9E0
};

const uint16_t snakeRedBody[] PROGMEM = {
  0x1426, 0x1426, 0xF9E0, 0xF9E0, 0xF9E0, 0xF9E0, 0xF9E0, 0xF9E0, 0x1426, 0x1426, 0x1426, 0xF9E0,
  0xF9E0, 0x12B0, 0x12B0, 0x12B0, 0x12B0, 0xF9E0, 0xF9E0, 0x1426, 0xF9E0, 0xF9E0, 0x12B0, 0x12B0,
  0xF9E0, 0xF9E0, 0x12B0, 0x12B0, 0xF9E0, 0xF9E0, 0xF9E0, 0x12B0, 0x12B0, 0xF9E0, 0xF9E0, 0xF9E0,
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  0xF9E0, 0xF9E0, 0x1426, 0x1426
};

const uint16_t headYellowUp[] PROGMEM = {
  0x1426, 0xFE60, 0xFFFF, 0xFE60, 0xF800, 0xF800, 0xFE60, 0xFFFF, 0xFE60, 0x1426, 0xFE60, 0xFE60,
  0xFFFF, 0xFE60, 0xF800, 0xFE60, 0xFE60, 0xFFFF, 0xFE60, 0xFE60, 0xFE60, 0xFE60, 0xFE60, 0xFE60,
  0xFE60, 0xFE60, 0xFE60, 0xFE60, 0xFE60, 0xFE60, 0x1426, 0xFE60, 0xFE60, 0xFE60, 0xFE60, 0xFE60,
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  0xFE60, 0xFE60, 0xFE60, 0xFE60
};

const uint16_t headYellowDown[] PROGMEM = {
  0xFE60, 0xFE60, 0xFE60, 0xFE60, 0xFE60, 0xFE60, 0xFE60, 0xFE60, 0xFE60, 0xFE60, 0xFE60, 0xFFFF,
  0xFFFF, 0xFFFF, 0xFE60, 0xFE60, 0xFFFF, 0xFFFF, 0xFFFF, 0xFE60, 0xFE60, 0xFFFF, 0x0000, 0x0000,
  0xFE60, 0xFE60, 0x0000, 0x0000, 0xFFFF, 0xFE60, 0xFE60, 0xFE60, 0xFE60, 0xFE60, 0xFE60, 0xFE60,
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  0xFE60, 0xFFFF, 0xFE60, 0x1426
};

const uint16_t headYellowLeft[] PROGMEM = {
  0x1426, 0xFE60, 0xFE60, 0x1426, 0x1426, 0xFE60, 0xFE60, 0xFE60, 0xFE60, 0xFE60, 0xFE60, 0xFE60,
  0xFE60, 0xFE60, 0xFE60, 0xFE60, 0xFE60, 0xFFFF, 0xFFFF, 0xFE60, 0xFFFF, 0xFFFF, 0xFE60, 0xFE60,
  0xFE60, 0xFE60, 0xFE60, 0x0000, 0xFFFF, 0xFE60, 0xFE60, 0xFE60, 0xFE60, 0xFE60, 0xFE60, 0xFE60,
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  0xFE60, 0xFE60, 0xFE60, 0xFE60
};

const uint16_t headYellowRight[] PROGMEM = {
  0xFE60, 0xFE60, 0xFE60, 0xFE60, 0xFE60, 0x1426, 0x1426, 0xFE60, 0xFE60, 0x1426, 0xFE60, 0xFFFF,
  0xFFFF, 0xFE60, 0xFE60, 0xFE60, 0xFE60, 0xFE60, 0xFE60, 0xFE60, 0xFE60, 0xFFFF, 0x0000, 0xFE60,
  0xFE60, 0xFE60, 0xFE60, 0xFE60, 0xFFFF, 0xFFFF, 0xFE60, 0xFFFF, 0x0000, 0xFE60, 0xFE60, 0xFE60,
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  0x1426, 0xFE60, 0xFE60, 0x1426
};

const uint16_t snakeYellowBody[] PROGMEM = {
  0x1426, 0x1426, 0xFE60, 0xFE60, 0xFE60, 0xFE60, 0xFE60, 0xFE60, 0x1426, 0x1426, 0x1426, 0xFE60,
  0xFE60, 0x12B0, 0x12B0, 0x12B0, 0x12B0, 0xFE60, 0xFE60, 0x1426, 0xFE60, 0xFE60, 0x12B0, 0x12B0,
  0xFE60, 0xFE60, 0x12B0, 0x12B0, 0xFE60, 0xFE60, 0xFE60, 0x12B0, 0x12B0, 0xFE60, 0xFE60, 0xFE60,
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  0xFE60, 0xFE60, 0x1426, 0x1426
};

namespace {

const int MAX_TAIL_LENGTH = 100;

BaitType randomNormalBaitType()
{
    return random(0, 2) == 0 ? BAIT_RED : BAIT_YELLOW;
}

BaitType randomSpecialBaitType()
{
    switch (random(0, 3))
    {
        case 0:
            return BAIT_GREEN;
        case 1:
            return BAIT_BLUE;
        default:
            return BAIT_RAINBOW;
    }
}

const uint16_t* getBaitBitmap(BaitType type)
{
    switch (type)
    {
        case BAIT_YELLOW:
            return baitYellowBmp;
        case BAIT_GREEN:
            return baitGreenBmp;
        case BAIT_BLUE:
            return baitBlueBmp;
        case BAIT_RAINBOW:
            return baitRainbowBmp;
        case BAIT_RED:
        default:
            return baitBmp;
    }
}

int getBaitScore(BaitType type)
{
    switch (type)
    {
        case BAIT_YELLOW:
            return 15;
        case BAIT_GREEN:
            return 15;
        case BAIT_BLUE:
            return 20;
        case BAIT_RAINBOW:
            return 15;
        case BAIT_RED:
        default:
            return 10;
    }
}

bool overlapsSnake(int x, int y)
{
    if (headX == x && headY == y)
    {
        return true;
    }

    for (int i = 0; i < nTail; ++i)
    {
        if (tailX[i] == x && tailY[i] == y)
        {
            return true;
        }
    }

    return false;
}

bool overlapsBait(const Bait& currentBait, int x, int y)
{
    return currentBait.active && currentBait.x == x && currentBait.y == y;
}

void initBaitAt(Bait& currentBait, BaitType type, const Bait* otherBait)
{
    int maxCol = SNAKE_BOARD_WIDTH / SNAKE_BLOCK_SIZE;
    int maxRow = SNAKE_BOARD_HEIGHT / SNAKE_BLOCK_SIZE;
    bool valid = false;

    while(!valid)
    {
        currentBait.x = random(0, maxCol) * SNAKE_BLOCK_SIZE;
        currentBait.y = random(0, maxRow) * SNAKE_BLOCK_SIZE;
        valid = !overlapsSnake(currentBait.x, currentBait.y);

        if (valid && otherBait != nullptr)
        {
            valid = !overlapsBait(*otherBait, currentBait.x, currentBait.y);
        }
    }

    currentBait.type = type;
    currentBait.active = true;
    currentBait.spawnedAt = millis();
}

void clearBait(const Bait& currentBait)
{
    if (!currentBait.active)
    {
        return;
    }

    tft_snake.fillRect(currentBait.x, currentBait.y, SNAKE_BLOCK_SIZE, SNAKE_BLOCK_SIZE, GAME_GREEN);
}

void growSnake()
{
    if (nTail < MAX_TAIL_LENGTH)
    {
        nTail++;
    }
}

void shrinkSnake()
{
    if (nTail <= 1)
    {
        return;
    }

    tft_snake.fillRect(tailX[nTail - 1], tailY[nTail - 1], SNAKE_BLOCK_SIZE, SNAKE_BLOCK_SIZE, GAME_GREEN);
    nTail--;
}

void applyBaitEffect(BaitType type)
{
    score += getBaitScore(type);

    switch (type)
    {
        case BAIT_GREEN:
            growSnake();
            moveDelay = min(moveDelay + SPEED_STEP, MAX_MOVE_DELAY);
            break;
        case BAIT_BLUE:
            growSnake();
            moveDelay = max(moveDelay - SPEED_STEP, MIN_MOVE_DELAY);
            break;
        case BAIT_RAINBOW:
            shrinkSnake();
            break;
        case BAIT_RED:
        case BAIT_YELLOW:
        default:
            growSnake();
            break;
    }
}

void spawnSpecialBait()
{
    if (specialBait.active)
    {
        return;
    }

    initBaitAt(specialBait, randomSpecialBaitType(), &bait);
}

}

snakeColor getColor()
{
    int temp = random(0, 3);
    switch(temp)
    {
        case 0:
            return RED;
        case 1:
            return BLUE;
        case 2:
            return YELLOW;
    }
    return BLUE;
}

void initBait()
{
    initBaitAt(bait, randomNormalBaitType(), specialBait.active ? &specialBait : nullptr);
}

void updateSpecialBait()
{
    if (!specialBait.active)
    {
        return;
    }

    if (currTime - specialBait.spawnedAt >= SPECIAL_BAIT_LIFETIME)
    {
        clearBait(specialBait);
        specialBait.active = false;
    }
}

// Reset snake to normal state
void resetSnake() {
    headX = 60;
    headY = 30;
    nTail = 1;
    tailX[0] = headX;
    tailY[0] = headY;
}

void readDirection()
{
    // Đọc cờ ngắt và chặn lỗi quay đầu 180 độ
    if (isUp && snakeDir != down) {
        snakeDir = up;
    }
    else if (isDown && snakeDir != up) {
        snakeDir = down;
    }
    else if (isLeft && snakeDir != right) {
        snakeDir = left;
    }
    else if (isRight && snakeDir != left) {
        snakeDir = right;
    }

    isUp = false;
    isDown = false;
    isLeft = false;
    isRight = false;
}

void move()
{
    prevTailX = tailX[nTail-1];
    prevTailY = tailY[nTail-1];
    int prevX = tailX[0];
    int prevY = tailY[0];
    tailX[0] = headX;
    tailY[0] = headY;
    int tempX, tempY;
    for (int i = 1; i < nTail; ++i)
    {
        tempX = tailX[i];
        tempY = tailY[i];
        tailX[i] = prevX;
        tailY[i] = prevY;
        prevX = tempX;
        prevY = tempY;
    }
    switch(snakeDir)
    {
        case up:
            headY-=SNAKE_BLOCK_SIZE;
            break;
        case down:
            headY+=SNAKE_BLOCK_SIZE;
            break;
        case left:
            headX-=SNAKE_BLOCK_SIZE;
            break;
        case right:
            headX+=SNAKE_BLOCK_SIZE;
            break;
    }
    // if (headX < 0) headX = SNAKE_BOARD_WIDTH - SNAKE_BLOCK_SIZE; else if (headX >= SNAKE_BOARD_WIDTH) headX = 0;
    // if (headY < 0) headY = SNAKE_BOARD_HEIGHT - SNAKE_BLOCK_SIZE; else if (headY >= SNAKE_BOARD_HEIGHT) headY = 0;

}

void isGameOver()
{
    if(headX < 0 || headX >= SNAKE_BOARD_WIDTH || headY < 0 || headY >= SNAKE_BOARD_HEIGHT)
       gameOver = true;
    for (int i = 0; i < nTail - 1; ++i)
    {
        if (headX == tailX[i] && headY == tailY[i]) 
        {
            gameOver = true;
            break;
        }
    }
}

bool eat()
{
    if (bait.active && headX == bait.x && headY == bait.y) 
    { 
        clearBait(bait);
        applyBaitEffect(bait.type);
        normalBaitEaten++;
        initBait();

        if (normalBaitEaten % 5 == 0)
        {
            spawnSpecialBait();
        }

        queueSend(SOUND_EAT);
        return true;
    }

    if (specialBait.active && headX == specialBait.x && headY == specialBait.y)
    {
        clearBait(specialBait);
        applyBaitEffect(specialBait.type);
        specialBait.active = false;
        queueSend(SOUND_EAT);
        return true;
    }

    return false;
}

void drawSnake(snakeColor color)
{
    
    tft_snake.fillRect(prevTailX, prevTailY, SNAKE_BLOCK_SIZE, SNAKE_BLOCK_SIZE, GAME_GREEN);
    const uint16_t* currentHeadBmp = headBlueRight; // Mặc định nếu mới vào game
    const uint16_t* snakeBody = snakeBlueBody;
    // 1. CHỌN MẢNG ĐẦU RẮN THEO HƯỚNG
    switch(color)
    {
        case BLUE:
            if (snakeDir == up) currentHeadBmp = headBlueUp;
            else if (snakeDir == down) currentHeadBmp = headBlueDown;
            else if (snakeDir == left) currentHeadBmp = headBlueLeft;
            else if (snakeDir == right) currentHeadBmp = headBlueRight;
            snakeBody = snakeBlueBody;
            break;
        case RED:
            if (snakeDir == up) currentHeadBmp = headRedUp;
            else if (snakeDir == down) currentHeadBmp = headRedDown;
            else if (snakeDir == left) currentHeadBmp = headRedLeft;
            else if (snakeDir == right) currentHeadBmp = headRedRight;
            snakeBody = snakeRedBody;
            break;
        case YELLOW:
            if (snakeDir == up) currentHeadBmp = headYellowUp;
            else if (snakeDir == down) currentHeadBmp = headYellowDown;
            else if (snakeDir == left) currentHeadBmp = headYellowLeft;
            else if (snakeDir == right) currentHeadBmp = headYellowRight;
            snakeBody = snakeYellowBody;
            break;
        default:
            break;
    }

    

    tft_snake.setSwapBytes(true);

    // 4. Vẽ thân rắn (Dùng pushImage cho mảng màu)
    // Cú pháp: pushImage(x, y, w, h, mảng);
    tft_snake.pushImage(tailX[0], tailY[0], SNAKE_BLOCK_SIZE, SNAKE_BLOCK_SIZE, (const uint16_t*)snakeBody);

    // 5. Vẽ đầu rắn
    tft_snake.pushImage(headX, headY, SNAKE_BLOCK_SIZE, SNAKE_BLOCK_SIZE, (const uint16_t*)currentHeadBmp);

    tft_snake.setSwapBytes(false); // Tắt sau khi vẽ xong
}


void drawBait(const Bait& currentBait)
{
    if (!currentBait.active)
    {
        return;
    }

    tft_snake.setSwapBytes(true);
    tft_snake.pushImage(currentBait.x, currentBait.y, SNAKE_BLOCK_SIZE, SNAKE_BLOCK_SIZE, (const uint16_t*)getBaitBitmap(currentBait.type));
    tft_snake.setSwapBytes(false);;
}

void drawBait()
{
    drawBait(bait);
    drawBait(specialBait);
}

void drawPlayingUI()
{
  // 1. Kẻ vạch phân cách màu trắng
  tft_snake.drawFastHLine(0, GAME_HEIGHT, SCREEN_WIDTH, TFT_WHITE); 
  
  // 2. Tô nền xám cho thanh UI ở đáy
  tft_snake.fillRect(0, GAME_HEIGHT + 1, SCREEN_WIDTH, SCREEN_HEIGHT - GAME_HEIGHT, TFT_DARKGREY); 

  // 3. In chữ TĨNH
  tft_snake.setTextSize(2);
  tft_snake.setTextColor(TFT_WHITE); // Chữ trắng nền trong suốt
  
  tft_snake.setCursor(10, GAME_HEIGHT + 12);
  tft_snake.print("SCORE: ");
  
  tft_snake.setCursor(180, GAME_HEIGHT + 12);
  tft_snake.print("BEST: ");

  // Gọi lần đầu để in luôn số điểm đang là 0
  drawScore();
}

void drawScore()
{
    tft_snake.setTextSize(2);
    tft_snake.setTextColor(TFT_WHITE, TFT_DARKGREY); 
    
    // Dịch tọa độ X ra sau chữ "SCORE: " (khoảng 85px)
    tft_snake.setCursor(85, GAME_HEIGHT + 12);
    tft_snake.printf("%05d", score); // In 3 chữ số (VD: 005)
    
    if (bestScore != prevBestScore)
    {
        // Dịch tọa độ X ra sau chữ "BEST: "
        tft_snake.setCursor(245, GAME_HEIGHT + 12);
        tft_snake.printf("%05d", bestScore);
        prevBestScore = bestScore;
    }
}

void drawFpsStats(const console::FpsStats& stats)
{
    tft_snake.fillRect(10, GAME_HEIGHT + 2, 170, 8, TFT_DARKGREY);
    tft_snake.setTextSize(1);
    tft_snake.setTextColor(TFT_CYAN, TFT_DARKGREY);
    tft_snake.setCursor(10, GAME_HEIGHT + 2);
    tft_snake.printf("FPS %u MN %u MX %u AV %u",
                     static_cast<unsigned int>(stats.current),
                     static_cast<unsigned int>(stats.minimum),
                     static_cast<unsigned int>(stats.maximum),
                     static_cast<unsigned int>(stats.average));
}

void renderBoard(bool &ate, snakeColor color)
{
    drawSnake(color);
    if(ate) 
        drawBait();
}

void drawGameOverUI()
{
    if(!drewGameOverUI)
    {
        tft_snake.setTextSize(2); 
        tft_snake.setTextColor(TFT_WHITE);
        
        // Căn giữa dựa theo GAME_HEIGHT thay vì SCREEN_HEIGHT
        tft_snake.setCursor(SCREEN_WIDTH/2 - 55, GAME_HEIGHT/2 - 10);
        tft_snake.println("GAME OVER");
        drewGameOverUI = true;
    }
}

void gameReset()
{
    score = 0;
    normalBaitEaten = 0;
    moveDelay = BASE_MOVE_DELAY;
    bait.active = false;
    specialBait.active = false;
    prevScore = -1; // Ép vẽ lại điểm số lần đầu
    prevBestScore = -1;
    resetSnake();
    snakeDir = right;
    gameOver = false;
    
    tft_snake.fillRect(0, 0, SCREEN_WIDTH, GAME_HEIGHT, GAME_GREEN); 
    drewGameOverUI = false;
    drawPlayingUI(); // Khởi tạo lại khung UI tĩnh
    initBait();
    drawBait();
}

}
